#include "Global_include.h"
#include "GlobalVar.h"

//#include "vector.h"

/*===========================================================================*/
// Файл содержит функции вызываемые из MakeOpis специфичные для привода АТ-24
/*===========================================================================*/
typedef u16  (*pntFuncU16_wm_type)(wm_type   *wm);    // тип указателя на функцию
typedef u16  (*pntFuncU16V_type)(void);
rcPrm_type rcPrm;       //---

extern const pntFuncV_WM_type pntMOvectFunc[16];

/*===========================================================================*/
/*===========================================================================*/
void checkSysCalc(void){
    
}
/*===========================================================================*/
// Функция для снятия 
/*===========================================================================*/
int MOspecialUnLock(wm_type   *wm, s16 Rd)
{
    //Semaphore_post(SEM_MOwrite_lock); // разлочить микропрограмму
    return 0;
}
/*===========================================================================*/
// Вызывается из MakeOpis
// По записи ставит LCK_pend и указатель на mosaf() где должен быть LCK_post
/*===========================================================================*/
Drv_err_type MOspecial(wm_type   *wm, s16 Rd)
{
  
    u16                 tmp;
    pntFuncV_WM_type    fPnt;

    if(Rd){     }   // Пока ни чего
    else{
//        Semaphore_pend(SEM_MOwrite_lock, BIOS_WAIT_FOREVER); // залочить микропрограмму
        wm->mosaf = MOspecialUnLock;
        
        tmp = (u16)((wm->Flags)>>FuncNumber_fprm)&FuncNumber_fprm_mask;
        fPnt = pntMOvectFunc[tmp];
        if(fPnt){
            tmp = fPnt(wm, Rd);         // Функция по номеру
            if( tmp !=0 ){
                wm->mosaf = NULL;
//                Semaphore_post(SEM_MOwrite_lock); // разлочить микропрограмму
                return (Drv_err_type)tmp; // Код ошибки
            }
        }   
    }
    return Ok_err;
}
/*===========================================================================*/
// Просто устанавливает флаг запроса на пересчет SysCalc
/*===========================================================================*/
u16  vectSetSysCalc(wm_type   *wm, s16 Rd){
    if(!Rd){
        GlobalM4.FlagCommand.bit.AciParamChange = 1;
    }
    return 0;
}
/*===========================================================================*/
/*===========================================================================*/

u16  changeTypeDrv(wm_type   *wm, s16 Rd){
    
    return 0;
}
/*===========================================================================*/
u16  vectSetRsDef(wm_type   *wm, s16 Rd){
    
    return 0;
}
/*===========================================================================*/
/*===========================================================================*/
u16  vectSetJDef(wm_type   *wm, s16 Rd){
    
    return 0;
}
/*===========================================================================*/
/*===========================================================================*/
// Запрос на изминение частоты ШИМ или мертвого времени
u16 ReInitPwm(wm_type   *wm, s16 Rd){
    if(!Rd){
        GlobalM4.FlagCommand.bit.PwmParamChange = 1;
    }
    return 0;
}

/*===========================================================================*/
/*===========================================================================*/
u16  vectSetAutoFase(wm_type   *wm, s16 Rd){
    
    return 0;
}
/*===========================================================================*/
/*===========================================================================*/
u16 rcParam(wm_type   *wm, s16 Rd)
{
    if(!Rd){ rcPrm.rc      = 1;}     // Запрос на пересчет
    return 0;
}
/*===========================================================================*/
/*===========================================================================*/
u16 checkEnWrPrm(wm_type   *wm, s16 Rd)
{
    if(wm->enablePrmChange == 0)    return IllegalFunc_err;
    else                            return 0;
}
/*===========================================================================*/
//          Массив указателей на функцию для векторных параметров
/*===========================================================================*/
const pntFuncV_WM_type pntMOvectFunc[16] = {
    NULL,                   // 0
    vectSetSysCalc,         // 1 
    changeTypeDrv,          // 2 
    vectSetRsDef,           // 3 
    vectSetJDef,            // 4 
    vectSetAutoFase,        // 5 
    NULL,                   // 6 
    NULL,                   // 7 
    NULL,                   // 8 
    NULL,                   // 9 
    ReInitPwm,              // 10
    NULL,                   // 11
    NULL,                   // 12
    NULL,                   // 13
    checkEnWrPrm,           // 14
    rcParam,                // 15
};
/*===========================================================================*/
/*===========================================================================*/

